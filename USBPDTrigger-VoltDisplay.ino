// 電圧表示付き USB PDトリガー
// ファームウェア v1.2
// WCH CH32X035
// 設計 @suzan_works

#include <SPI.h>
#include <usbpd_def.h>
#include <usbpd_sink.h>

uint8_t setVoltage = REQUEST_5v;

// PD出力設定番号、0=5V,1=9V,2=12V,3=15V,4=20V
int pdNum = 0;

#define OLED_CS PA4
#define OLED_DC PA3
#define OLED_RESET PA2

#define btnAPin D0
#define btnBPin D20
#define vbusDividedPin PA1
#define outputPin PC0
#define ledPin D15

bool isLight = 0;
bool isOutput = 0;

float volt = 5.0;

// OLEDディスプレイ表示関連
bool displayData[128][32];
byte convertData[512];
byte reverseData[512];

// SSD1306 Commands
#define SSD1306_DISPLAYOFF 0xAE
#define SSD1306_SETDISPLAYCLOCKDIV 0xD5
#define SSD1306_SETMULTIPLEX 0xA8
#define SSD1306_SETDISPLAYOFFSET 0xD3
#define SSD1306_SETSTARTLINE 0x40
#define SSD1306_CHARGEPUMP 0x8D
#define SSD1306_MEMORYMODE 0x20
#define SSD1306_SEGREMAP 0xA1
#define SSD1306_COMSCANDEC 0xC8
#define SSD1306_SETCOMPINS 0xDA
#define SSD1306_SETCONTRAST 0x81
#define SSD1306_DISPLAYALLON_RESUME 0xA4
#define SSD1306_NORMALDISPLAY 0xA6
#define SSD1306_DISPLAYON 0xAF

// フォントデータ
bool numData[10][32][16] =
	{{{0, 0, 0, 0, 0, 0, 0, 0, 0, 0, 0, 0, 0, 0, 0, 0},
	  {0, 0, 0, 0, 0, 0, 0, 0, 0, 0, 0, 0, 0, 0, 0, 0},
	  {0, 0, 0, 0, 0, 0, 0, 0, 0, 0, 0, 0, 0, 0, 0, 0},
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	  {0, 0, 0, 0, 0, 0, 0, 0, 0, 0, 0, 0, 0, 0, 0, 0}}};

bool sData[32][10] =
	{
		{0, 0, 0, 0, 0, 0, 0, 0, 0, 0},
		{0, 0, 0, 0, 0, 0, 0, 0, 0, 0},
		{0, 0, 0, 0, 0, 0, 0, 0, 0, 0},
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		{0, 0, 0, 0, 0, 0, 0, 0, 0, 0}};

bool mData[32][10] =
	{
		{0, 0, 0, 0, 0, 0, 0, 0, 0, 0},
		{0, 0, 0, 0, 0, 0, 0, 0, 0, 0},
		{0, 0, 0, 0, 0, 0, 0, 0, 0, 0},
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		{0, 0, 0, 0, 0, 0, 0, 0, 0, 0}};

bool vData[32][10] =
	{
		{0, 0, 0, 0, 0, 0, 0, 0, 0, 0},
		{0, 0, 0, 0, 0, 0, 0, 0, 0, 0},
		{0, 0, 0, 0, 0, 0, 0, 0, 0, 0},
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		{0, 0, 0, 0, 0, 0, 0, 0, 0, 0}};

bool barData[32][4] =
	{
		{0, 1, 1, 0},
		{0, 1, 1, 0},
		{0, 1, 1, 0},
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		{0, 1, 1, 0}};

bool pointData[32][4] =
	{
		{0, 0, 0, 0},
		{0, 0, 0, 0},
		{0, 0, 0, 0},
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		{0, 0, 0, 0}};

// 数値を表示データに変換する
void floatToDisplayData(float value, int pdNum)
{
	int tens = int(value) / 10;		  // Extract the tens digit.
	int ones = int(value) % 10;		  // Extract the ones digit.
	int tenth = int(value * 10) % 10; // Extract the tenth place digit after the decimal.

	// Populate displayData using numData.
	for (int y = 0; y < 32; y++)
	{
		for (int x = 0; x < 128; x++)
		{
			if ((x >= 0) && (x < 10))
			{
				displayData[x][y] = sData[y][x];
			}
			if ((x >= 10) && (x < 26))
			{
				switch (pdNum)
				{
				case 0:
					displayData[x][y] = numData[0][y][(x - 10)];
					break;
				case 1:
					displayData[x][y] = numData[0][y][(x - 10)];
					break;
				case 2:
					displayData[x][y] = numData[1][y][(x - 10)];
					break;
				case 3:
					displayData[x][y] = numData[1][y][(x - 10)];
					break;
				case 4:
					displayData[x][y] = numData[2][y][(x - 10)];
					break;

				default:
					break;
				}
			}
			if ((x >= 26) && (x < 42))
			{
				switch (pdNum)
				{
				case 0:
					displayData[x][y] = numData[5][y][(x - 26)];
					break;
				case 1:
					displayData[x][y] = numData[9][y][(x - 26)];
					break;
				case 2:
					displayData[x][y] = numData[2][y][(x - 26)];
					break;
				case 3:
					displayData[x][y] = numData[5][y][(x - 26)];
					break;
				case 4:
					displayData[x][y] = numData[0][y][(x - 26)];
					break;

				default:
					break;
				}
			}
			if ((x >= 42) && (x < 52))
			{
				displayData[x][y] = vData[y][(x - 42)];
			}
			if ((x >= 52) && (x < 56))
			{
				displayData[x][y] = barData[y][(x - 52)];
			}
			if ((x >= 56) && (x < 66))
			{
				displayData[x][y] = mData[y][(x - 56)];
			}
			if ((x >= 66) && (x < 82))
			{
				displayData[x][y] = numData[tens][y][(x - 66)];
			}
			if ((x >= 82) && (x < 98))
			{
				displayData[x][y] = numData[ones][y][(x - 82)];
			}
			if ((x >= 98) && (x < 102))
			{
				displayData[x][y] = pointData[y][(x - 98)];
			}
			if ((x >= 102) && (x < 118))
			{
				displayData[x][y] = numData[tenth][y][(x - 102)];
			}
			if ((x >= 118) && (x < 128))
			{
				displayData[x][y] = vData[y][(x - 118)];
			}
		}
	}
}

// SPI送信データに変換する
void displayToConvertData()
{
	for (int x = 0; x < 128; x++)
	{
		for (int yByte = 0; yByte < 4; yByte++)
		{
			convertData[x + (yByte * 128)] = 0;
			for (int bit = 0; bit < 8; bit++)
			{
				if (displayData[x][bit + (yByte * 8)])
				{
					convertData[x + (yByte * 128)] |= (1 << bit);
				}
			}
		}
	}
}

// データ変換
void convertToReverseData()
{
	for (int i = 0; i < 512; i++)
	{
		reverseData[i] = ((convertData[i] & 0b00000001) << 7) |
						 ((convertData[i] & 0b00000010) << 5) |
						 ((convertData[i] & 0b00000100) << 3) |
						 ((convertData[i] & 0b00001000) << 1) |
						 ((convertData[i] & 0b00010000) >> 1) |
						 ((convertData[i] & 0b00100000) >> 3) |
						 ((convertData[i] & 0b01000000) >> 5) |
						 ((convertData[i] & 0b10000000) >> 7);
	}
}

// SPI送信
void sendCommand(uint8_t command)
{
	digitalWrite(OLED_DC, LOW);	 // Command mode
	SPI.transfer(command);		 // Send command byte
	digitalWrite(OLED_DC, HIGH); // Data mode
}

// ボタンチャタリング防止用の変数
unsigned long currentTime = 0;
unsigned long previousTime = 0;
const unsigned long interval = 80; // 判定間隔(ミリ秒)
bool btnAState = 1;
bool btnBState = 1;
bool previousBtnAState = 1;
bool previousBtnBState = 1;
int previousPdNum = 0;
int voltRead = 0;

void setup()
{
	pinMode(OLED_CS, OUTPUT);
	pinMode(OLED_DC, OUTPUT);
	pinMode(OLED_RESET, OUTPUT);

	pinMode(btnAPin, INPUT_PULLUP);
	pinMode(btnBPin, INPUT_PULLUP);
	pinMode(vbusDividedPin, INPUT);
	pinMode(outputPin, OUTPUT);
	pinMode(ledPin, OUTPUT);
	digitalWrite(outputPin, isOutput);
	digitalWrite(ledPin, isLight);

	Serial.begin(115200);
	Serial.println("setup");

	usbpd_sink_init();

	SPI.begin();

	// OLEDリセット
	digitalWrite(OLED_RESET, LOW);
	delay(10);
	digitalWrite(OLED_RESET, HIGH);
	delay(10);

	// SPI通信設定
	SPI.beginTransaction(SPISettings(100000, MSBFIRST, SPI_MODE0));
	digitalWrite(OLED_CS, LOW); // Enable OLED by setting CS to LOW

	// OLEDイニシャルコマンド
	sendCommand(SSD1306_DISPLAYOFF);
	sendCommand(SSD1306_SETDISPLAYCLOCKDIV);
	sendCommand(0x80);
	sendCommand(SSD1306_SETMULTIPLEX);
	sendCommand(0x1F);
	sendCommand(SSD1306_SETDISPLAYOFFSET);
	sendCommand(0x0);
	sendCommand(SSD1306_SETSTARTLINE);
	sendCommand(SSD1306_CHARGEPUMP);
	sendCommand(0x14);
	sendCommand(SSD1306_MEMORYMODE);
	sendCommand(0x00);
	sendCommand(SSD1306_SEGREMAP);
	sendCommand(SSD1306_COMSCANDEC);
	sendCommand(SSD1306_SETCOMPINS);
	sendCommand(0x02);
	sendCommand(SSD1306_SETCONTRAST);
	sendCommand(0x8F);
	sendCommand(SSD1306_DISPLAYALLON_RESUME);
	sendCommand(SSD1306_NORMALDISPLAY);
	sendCommand(SSD1306_DISPLAYON);

	digitalWrite(OLED_CS, HIGH);
	SPI.endTransaction();
}

void loop()
{
	// ボタンチャタリング防止、ディスプレイちらつき防止
	currentTime = millis();
	if ((currentTime - previousTime) >= interval)
	{
		previousTime = currentTime;
		previousBtnAState = btnAState;
		previousBtnBState = btnBState;		
		btnAState = digitalRead(btnAPin);
		btnBState = digitalRead(btnBPin);

		// 電圧読み取りサンプルを取得して平均値を計算
		int sum = 0;
		for (int i = 0; i < 10; i++)
		{
			sum += analogRead(vbusDividedPin);
			delay(1); // 必要に応じて遅延を追加
		}
		voltRead = sum / 10; 
	}

	if ((previousBtnAState == 0)&&(btnAState == 0))
	{
		//Serial.println("btnA");
		btnAState = 1;
		pdNum = (pdNum + 1) % 5;
		isOutput = 0;
		isLight = 0;
	}

	if ((previousBtnBState == 0)&&(btnBState == 0))
	{
		//Serial.println("btnB");
		btnBState = 1;
		isOutput = !isOutput;
		isLight = !isLight;
	}

	if (pdNum != previousPdNum)
	{
		//Serial.println("pdNum");

		switch (pdNum)
		{
		case 0:
			setVoltage = REQUEST_5v;
			break;
		case 1:
			setVoltage = REQUEST_9v;
			break;
		case 2:
			setVoltage = REQUEST_12v;
			break;
		case 3:
			setVoltage = REQUEST_15v;
			break;
		case 4:
			setVoltage = REQUEST_20v;
			break;

		default:
			break;
		}

		if (usbpd_sink_get_ready())
		{
			usbpd_sink_set_request_fixed_voltage(setVoltage);
		}

		previousPdNum = pdNum;
	}
	
	digitalWrite(outputPin, isOutput);
	digitalWrite(ledPin, isLight);

	// 12bit
	float result = (float)voltRead / 4095;
	// 1k/10k分圧、現物合わせで表示値調整
	volt = (11 * 3.3 * result) * 0.9465 - 0.0989;

	// OLED表示
	SPI.beginTransaction(SPISettings(100000, MSBFIRST, SPI_MODE0));
	digitalWrite(OLED_CS, LOW);	 // Enable OLED
	digitalWrite(OLED_DC, HIGH); // Data mode

	floatToDisplayData(volt, pdNum);
	displayToConvertData();
	convertToReverseData();

	for (int i = 0; i < 512; i++)
	{
		SPI.transfer(convertData[i]);
	}

	digitalWrite(OLED_CS, HIGH); // Disable OLED
	SPI.endTransaction();		 // End the SPI transaction
}